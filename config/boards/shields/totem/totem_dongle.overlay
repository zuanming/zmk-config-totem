/*
 * Copyright (c) 2024 The ZMK Contributors
 *
 * SPDX-License-Identifier: MIT
 */

#include "totem.dtsi"
/ {

    chosen {
        zephyr,display = &oled;
        zmk,kscan = &mock_kscan;
        zmk,physical-layout = &totem_layout;
    };

    mock_kscan: kscan_0 {
        compatible = "zmk,kscan-mock";
        columns = <0>;
        rows = <0>;
        events = <0>;
    };
};
